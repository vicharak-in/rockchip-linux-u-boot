## arch/arm/mach-rockchip/rk3399/Kconfig
```kconfig
if ROCKCHIP_RK3399

choice
	prompt "RK3399 board select"

config TARGET_EVB_RK3399
	bool "RK3399 evaluation board"
	select BOARD_LATE_INIT
	help
	  RK3399evb is a evaluation board for Rockchp rk3399,
	  with full function and phisical connectors support like type-C ports,
	  usb2.0 host ports, LVDS, JTAG, MAC, SDcard, HDMI, USB-2-serial...

config TARGET_PUMA_RK3399
	bool "Theobroma Systems RK3399-Q7 (Puma)"
	help
	  The RK3399-Q7 (Puma) is a system-on-module (designed and
	  marketed by Theobroma Systems) featuring the Rockchip RK3399
	  in a Qseven-compatible form-factor (running of a single 5V
	  supply and exposing its external interfaces on a MXM-230
	  connector).

	  Key features of the RK3399-Q7 include:
	   * on-module USB 3.0 hub (2x USB 3.0 host + 1x USB 2.0 host)
	   * USB 3.0 dual-role
	   * on-module Micrel KSZ9031 GbE PHY
	   * on-module eMMC (up to 256GB configurations available)
	   * on-module DDR3 (1GB, 2GB and 4GB configurations available)
	   * HDMI, eDP, MIPI-DSI, MIPI-DSI/CSI and MIPI-CSI
	   * SPI, I2C, I2S, UART, GPIO, ...

config TARGET_RK3399_VAAMAN
	bool "Vicharak RK3399 Vaaman board"
	select BOARD_LATE_INIT
	help
	  The Vaaman is a Single Board Computer (SBC) designed by Vicharak,
	  which is powered by the RK3399 processor.
	  It features a 2 x Cortex-ARM A72 MPCore processor and 4 x ARM Cortex-A53 MPCore processor.
	  ARM Mali-T860MP4 GPU, and 2GB LPDDR4-3200 SDRAM.
	  16GB/32GB/128GB high-speed eMMC storage options,
	  microSD (TF) card slot, and PCIE for extended SSD.

	  1 x HDMI 2.0 (Micro) and 1 x MIPI display output,
	  3.5mm jack with a mic for audio, 10/100/1000Mbps Ethernet,
	  MIPI CSI 2 lanes via FPC connector for cameras,
	  and integrated WiFi combo module supporting 2.4G+5G WiFi 2T2R and BT5.0.

	  It also has a PCIe interface, USB 2.0 and 3.0 ports, RTC, and a variety of IO options,
	  including UART, SPI bus, I2C bus, PCM/I2S, SPDIF, PWM, ADC, and GPIO.

	  Additionally, it features an LVDS tx and rx interface connector that supports 20 lanes,
	  LPDDR3 256Mbits x 16 bits memory,

	  MIPI-CSI RX connector with 4 data lanes and 1 clock lane,
	  MIPI-CSI TX connector with 4 data lanes and 1 clock lane,
	  JTAG headers for configuration,
	  a 40-pin GPIO header supported with 1 PMOD and 2 LVDS lanes, and five different oscillators.


endchoice

config SYS_SOC
	default "rockchip"

config SYS_MALLOC_F_LEN
	default 0x0800

config SPL_STACK_R_ADDR
	default 0x04000000

source "board/rockchip/evb_rk3399/Kconfig"
source "board/theobroma-systems/puma_rk3399/Kconfig"
source "board/rockchip/rk3399_vaaman/Kconfig"

endif
```

## arch/arm/mach-rockchip/rk3588/Kconfig
```kconfig
if ROCKCHIP_RK3588

config TARGET_EVB_RK3588
	bool "EVB_RK3588"
	select BOARD_LATE_INIT
	help
	  RK3588 EVB is a evaluation board for Rockchp RK3588.

config SYS_SOC
	default "rockchip"

config SYS_MALLOC_F_LEN
	default 0x400

config TARGET_RK3588_AXON
	bool "Vicharak RK3588 Axon board"
	select BOARD_LATE_INIT
	help
	  The Axon is a Single Board Computer (SBC) designed by Vicharak,
	  which is powered by the RK3588 processor.

	  The board features a dual-channel DDR4 RAM configuration
	  with a total capacity of 8GB, as well as storage options
	  including SATA, NVMe, eMMC, and SDMMC.

	  Other notable features include a 1GBps LAN connection,
	  RTL8852BS-based WiFi and Bluetooth module,
	  ES8388 Audio codec support, MIPI CSI RX x 2,
	  MIPI DCPHY RX x 2, MIPI DCPHY TX x 2 and 3 x PCIe 2.0 and 1 x 3.0 slots.

	  The Axon also includes a variety of header pins
	  for UART, I2C, SPI, and SARADC connectivity,
	  as well as micro HDMI ports and
	  2 x USB Type-C connectors for power delivery, 3.1 USB and DP.

source board/rockchip/evb_rk3588/Kconfig
source board/rockchip/rk3588_axon/Kconfig

endif
```

## board/rockchip/rk3399_vaaman/Kconfig
```kconfig
if TARGET_RK3399_VAAMAN

config SYS_BOARD
	default "rk3399_vaaman"

config SYS_VENDOR
	default "rockchip"

config SYS_CONFIG_NAME
	default "rk3399_vaaman"

config BOARD_SPECIFIC_OPTIONS
	def_bool y

endif
```

## board/rockchip/rk3588_axon/Kconfig
```kconfig
if TARGET_RK3588_AXON

config SYS_BOARD
	default "rk3588_axon"

config SYS_VENDOR
	default "rockchip"

config SYS_CONFIG_NAME
	default "rk3588_axon"

config BOARD_SPECIFIC_OPTIONS
	def_bool y

endif
```

## configs/rock-pi-s-rk3308_defconfig
```kconfig
CONFIG_ARM=y
CONFIG_SKIP_LOWLEVEL_INIT=y
CONFIG_ARCH_ROCKCHIP=y
CONFIG_SYS_TEXT_BASE=0x00600000
CONFIG_SPL_GPIO_SUPPORT=y
CONFIG_SPL_LIBCOMMON_SUPPORT=y
CONFIG_SPL_LIBGENERIC_SUPPORT=y
CONFIG_SYS_MALLOC_F_LEN=0x2000
CONFIG_ROCKCHIP_RK3308=y
CONFIG_ROCKCHIP_SPL_RESERVE_IRAM=0x0
CONFIG_SPL_DRIVERS_MISC_SUPPORT=y
CONFIG_TARGET_EVB_RK3308=y
CONFIG_SPL_STACK_R_ADDR=0xc00000
CONFIG_PRE_CON_BUF_ADDR=0x0f200000
CONFIG_DEBUG_UART_BASE=0xFF0C0000
CONFIG_DEBUG_UART_CLOCK=24000000
CONFIG_SPL_LIBDISK_SUPPORT=y
CONFIG_DEFAULT_DEVICE_TREE="rk3308-rock-pi-s"
CONFIG_DEBUG_UART=y
CONFIG_SYS_LOAD_ADDR=0x800800
CONFIG_BAUDRATE=1500000
# CONFIG_LOCALVERSION_AUTO is not set
CONFIG_ANDROID_BOOT_IMAGE=y
CONFIG_FIT=y
CONFIG_FIT_VERBOSE=y
CONFIG_PRE_CONSOLE_BUFFER=y
CONFIG_CONSOLE_MUX=y
CONFIG_SYS_CONSOLE_ENV_OVERWRITE=y
# CONFIG_SYS_DEVICE_NULLDEV is not set
CONFIG_DEFAULT_FDT_FILE="rk3308-rock-pi-s.dtb"
CONFIG_MISC_INIT_R=y
CONFIG_VERSION_VARIABLE=y
# CONFIG_DISPLAY_CPUINFO is not set
CONFIG_DISPLAY_BOARDINFO_LATE=y
CONFIG_BOARD_TYPES=y
CONFIG_SPL_STACK_R=y
CONFIG_SYS_MMCSD_RAW_MODE_U_BOOT_USE_PARTITION=y
CONFIG_CMD_CONFIG=y
# CONFIG_CMD_ELF is not set
# CONFIG_CMD_IMI is not set
# CONFIG_CMD_XIMG is not set
CONFIG_CMD_GPT=y
# CONFIG_CMD_LOADB is not set
# CONFIG_CMD_LOADS is not set
CONFIG_CMD_MMC=y
CONFIG_CMD_USB=y
CONFIG_CMD_USB_MASS_STORAGE=y
# CONFIG_CMD_ITEST is not set
# CONFIG_CMD_SETEXPR is not set
# CONFIG_ISO_PARTITION is not set
CONFIG_EFI_PARTITION_ENTRIES_NUMBERS=64
CONFIG_SPL_OF_CONTROL=y
CONFIG_OF_LIVE=y
CONFIG_OF_SPL_REMOVE_PROPS="pinctrl-0 pinctrl-names clock-names interrupt-parent assigned-clocks assigned-clock-rates assigned-clock-parents"
CONFIG_SYS_RELOC_GD_ENV_ADDR=y
CONFIG_REGMAP=y
CONFIG_SYSCON=y
CONFIG_CLK=y
# CONFIG_USB_FUNCTION_FASTBOOT is not set
CONFIG_SPL_FIRMWARE=y
CONFIG_ROCKCHIP_GPIO=y
CONFIG_SYS_I2C_ROCKCHIP=y
CONFIG_LED=y
CONFIG_LED_GPIO=y
CONFIG_MMC_DW=y
CONFIG_MMC_DW_ROCKCHIP=y
CONFIG_MMC_SDHCI=y
CONFIG_MMC_SDHCI_ROCKCHIP=y
CONFIG_PHY_REALTEK=y
CONFIG_DM_ETH=y
CONFIG_PHY_GIGE=y
CONFIG_ETH_DESIGNWARE=y
CONFIG_RGMII=y
CONFIG_MII=y
CONFIG_GMAC_ROCKCHIP=y
CONFIG_PHY_ROCKCHIP_INNO_USB2=y
CONFIG_PINCTRL=y
CONFIG_DM_PMIC=y
CONFIG_PMIC_RK8XX=y
CONFIG_REGULATOR_PWM=y
CONFIG_DM_REGULATOR_FIXED=y
CONFIG_PWM_ROCKCHIP=y
CONFIG_RAM=y
CONFIG_ROCKCHIP_SDRAM_COMMON=y
CONFIG_DM_RESET=y
CONFIG_DEBUG_UART_SHIFT=2
CONFIG_ROCKCHIP_SPI=y
CONFIG_SYSRESET=y
CONFIG_USB=y
CONFIG_DM_USB_GADGET=y
CONFIG_SPL_DM_USB_GADGET=y
CONFIG_USB_EHCI_HCD=y
CONFIG_USB_EHCI_GENERIC=y
CONFIG_USB_DWC2=y
CONFIG_USB_DWC3=y
CONFIG_ROCKCHIP_USB2_PHY=y
CONFIG_USB_KEYBOARD=y
CONFIG_USB_GADGET=y
CONFIG_USB_GADGET_DWC2_OTG=y
CONFIG_USB_GADGET_DOWNLOAD=y
CONFIG_EXT4_WRITE=y
CONFIG_SPL_TINY_MEMSET=y
CONFIG_LZO=y
CONFIG_ERRNO_STR=y
# CONFIG_EFI_LOADER is not set
```
